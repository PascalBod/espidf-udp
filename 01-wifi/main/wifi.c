/**
 * Copyright 2021 Pascal Bodin
 */

#include <stdbool.h>

#include "esp_system.h"
#include "esp_wifi.h"
#include "esp_event.h"
#include "esp_log.h"

#include "freertos/FreeRTOS.h"
#include "freertos/queue.h"

#include "messages.h"
#include "wifi.h"

static const char *TAG = "WIF";

static const wifi_country_t COUNTRY_CONF_FR = {
		.cc = "FR ",
		.schan = 1,
		.nchan = 13,
		.max_tx_power = 0,  // Used only when reading the configuration.
		.policy = WIFI_COUNTRY_POLICY_MANUAL
};
// Max TX power for France is 100 mW, i.e. 20 dBm:
// https://w.wol.ph/2015/08/28/maximum-wifi-transmission-power-country/
// According to ESP32 documentation, 20 must be passed to esp_wifi_set_max_tx_power():
// https://docs.espressif.com/projects/esp-idf/en/stable/esp32/api-reference/network/esp_wifi.html#_CPPv425esp_wifi_set_max_tx_power6int8_t
#define MAX_POWER_FR 20

// ESP-NETIF instance.
static esp_netif_t *netif_instance_ptr;

// To read default country configuration.
static wifi_country_t default_country_conf;

// Queue where to send events. Set by init_wifi().
static QueueHandle_t comm_queue;

/**
 * Event handler for events generated by the Wi-Fi task and the LwIP task.
 */
static void event_handler(void* arg, esp_event_base_t event_base,
                                int32_t event_id, void* event_data) {

	ESP_LOGI(TAG, "Event: %s-%d", event_base, event_id);

	msg_t message;
	message.msg_type = MSG_WIFI_UNSUPP_EVENT;
	if (event_base == WIFI_EVENT && event_id == WIFI_EVENT_STA_START) {
		ESP_LOGI(TAG, "WIFI_EVENT_STA_START");
	    message.msg_type = MSG_WIFI_STA_OK;
	}
	if (event_base == WIFI_EVENT && event_id == WIFI_EVENT_STA_DISCONNECTED) {
		// We were not able to connect, or we were connected and got disconnected.
		ESP_LOGI(TAG, "WIFI_EVENT_STA_DISCONNECTED");
	    message.msg_type = MSG_WIFI_STA_KO;
	}
	if (event_base == WIFI_EVENT && event_id == WIFI_EVENT_SCAN_DONE) {
		ESP_LOGI(TAG, "WIFI_EVENT_SCAN_DONE");
		message.msg_type = MSG_WIFI_SCAN_DONE;
	}
	if (event_base == WIFI_EVENT && event_id == WIFI_EVENT_STA_STOP) {
		ESP_LOGI(TAG, "WIFI_EVENT_STA_STOP");
		message.msg_type = MSG_WIFI_STA_STOP;
	}
	if (event_base == IP_EVENT && event_id == IP_EVENT_STA_GOT_IP) {
		// We are connected, and got an IP address.
		ESP_LOGI(TAG, "IP_EVENT_STA_GOT_IP");
	    message.msg_type = MSG_WIFI_IP_OK;
	}
	BaseType_t rs = xQueueSend(comm_queue, &message, 0);
	if (rs != pdTRUE) {
		// Internal error!
		ESP_LOGE(TAG, "Internal error - xQueueSend - %d", rs);
	}

}

wifi_status_t init_wifi(QueueHandle_t input_queue) {

	comm_queue = input_queue;

	esp_err_t esp_rs;

	netif_instance_ptr = esp_netif_create_default_wifi_sta();
	wifi_init_config_t cfg = WIFI_INIT_CONFIG_DEFAULT();
	esp_rs = esp_wifi_init(&cfg);
	if (esp_rs != ESP_OK) {
		ESP_LOGE(TAG, "Error from esp_wifi_init: %d", esp_rs);
		return WIFI_INIT_ERR;
	}
	// Register our event_handle that will receive Wi-Fi task events.
	esp_rs = esp_event_handler_register(WIFI_EVENT, ESP_EVENT_ANY_ID, &event_handler, NULL);
	if (esp_rs != ESP_OK) {
		ESP_LOGE(TAG, "Error from esp_event_handler_register: %d", esp_rs);
		return WIFI_HND_REG_ERR;
	}
	// And register the same event handler to receive the event telling that an
	// IP address has been assigned. esp_netif will automatically start the DHCP client
	// once the Wi-Fi task is connected to the AP.
	esp_rs = esp_event_handler_instance_register(IP_EVENT, IP_EVENT_STA_GOT_IP,
												 &event_handler, NULL, NULL);
	if (esp_rs != ESP_OK) {
		ESP_LOGE(TAG, "Error from esp_event_handler_instance_register: %d", esp_rs);
		esp_wifi_deinit();
		return WIFI_HND_REG_ERR;
	}
	esp_rs = esp_wifi_set_mode(WIFI_MODE_STA);
	if (esp_rs != ESP_OK) {
		ESP_LOGE(TAG, "Error from esp_wifi_set_mode: %d", esp_rs);
		esp_wifi_deinit();
		return WIFI_STA_ERR;
	}
	// Display default country configuration.
	esp_rs = esp_wifi_get_country(&default_country_conf);
	if (esp_rs != ESP_OK) {
		ESP_LOGE(TAG, "Error from esp_wifi_get_country: %d", esp_rs);
		esp_wifi_deinit();
		return WIFI_GET_CNTR_ERR;
	}
	ESP_LOGI(TAG, "Default country conf: \n"
			      "  cc:     %c%c%c\n"
				  "  schan:  %d\n"
			      "  nchan:  %d\n"
			      "  tx pwr: %d\n"
			      "  policy: %d",
				  default_country_conf.cc[0], default_country_conf.cc[1], default_country_conf.cc[2],
				  default_country_conf.schan,
				  default_country_conf.nchan,
				  default_country_conf.max_tx_power,
				  default_country_conf.policy);
	// Set country configuration.
	esp_rs = esp_wifi_set_country(&COUNTRY_CONF_FR);
	if (esp_rs != ESP_OK) {
		ESP_LOGE(TAG, "Error from esp_wifi_set_country: %d", esp_rs);
		esp_wifi_deinit();
		return WIFI_SET_CNTR_ERR;
	}
	esp_rs = esp_wifi_start();
	if (esp_rs != ESP_OK) {
		ESP_LOGE(TAG, "Error from esp_wifi_start: %d", esp_rs);
		esp_wifi_deinit();
		return WIFI_START_ERR;
	}
	// Must be called after esp_wifi_start().
	esp_rs = esp_wifi_set_max_tx_power(MAX_POWER_FR);
	if (esp_rs != ESP_OK) {
		ESP_LOGE(TAG, "Error from esp_wifi_set_max_tx_power: %d", esp_rs);
		esp_wifi_stop();
		esp_wifi_deinit();
		return WIFI_SET_PWR_ERR;
	}

	return WIFI_OK;

}

wifi_status_t stop_wifi(void) {

	esp_netif_destroy(netif_instance_ptr);
	return WIFI_OK;

}
